## boards/shields/cradio/Kconfig.defconfig
```kconfig
if SHIELD_CRADIO_CENTRAL_DONGLE || SHIELD_CRADIO_CENTRAL_LEFT

config ZMK_KEYBOARD_NAME
    default "Cradio"

config ZMK_SPLIT_ROLE_CENTRAL
    default y

endif

if SHIELD_CRADIO_CENTRAL_DONGLE || SHIELD_CRADIO_CENTRAL_LEFT || SHIELD_CRADIO_PERIPHERAL_LEFT || SHIELD_CRADIO_PERIPHERAL_RIGHT

config ZMK_SPLIT
    default y

endif
```

## boards/shields/cradio/Kconfig.shield
```kconfig
config SHIELD_CRADIO_CENTRAL_DONGLE
    def_bool $(shields_list_contains,cradio_central_dongle)

config SHIELD_CRADIO_CENTRAL_LEFT
    def_bool $(shields_list_contains,cradio_central_left)

config SHIELD_CRADIO_PERIPHERAL_LEFT
    def_bool $(shields_list_contains,cradio_peripheral_left)

config SHIELD_CRADIO_PERIPHERAL_RIGHT
    def_bool $(shields_list_contains,cradio_peripheral_right)
```
